## drivers/net/wireless/mediatek/mt76/Kconfig
```kconfig
config MT76_CORE
	depends on !KERNEL_4_1
	tristate
	depends on m

config MT76x2E
	depends on !KERNEL_4_1
	tristate "MediaTek MT76x2E (PCIe) support"
	depends on m
	select MT76_CORE
	depends on MAC80211
	depends on PCI
	---help---
	  This adds support for MT7612/MT7602/MT7662-based wireless PCIe devices.
```
